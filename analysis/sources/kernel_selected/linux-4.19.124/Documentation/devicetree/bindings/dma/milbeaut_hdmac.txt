## analysis/sources/kernel_selected/linux-4.19.124/Documentation/devicetree/bindings/dma/milbeaut_hdmac.txt
```
* Milbeaut AHB DMA Controller

Milbeaut AHB DMA controller has transfer capability bellow.
 - memory to memory transfer
 - device to memory transfer
 - memory to device transfer

Required property:
- compatible:       Should be  "socionext,milbeaut_hdmac" for M10V
                    Should be  "socionext,milbeaut_m20v_hdmac" for M20V
- reg:              Should contain DMA registers location and length.
- interrupts:       Should contain all of the per-channel DMA interrupts.
- #dma-cells:       Should be 1.
- clocks:           Phandle to the clock used by the HDMAC module.

Optional properties:
- priority-rotate:  The priority of all DMA channels is rotated.

Example:

	hdmac1: hdmac@1e110000 {
		compatible = "socionext,milbeaut_hdmac";
		reg = <0x1e110000 0x10000>;
		interrupts = <0 132 4>,
			     <0 133 4>,
			     <0 134 4>,
			     <0 135 4>,
			     <0 136 4>,
			     <0 137 4>,
			     <0 138 4>,
			     <0 139 4>;
		#dma-cells = <1>;
		priority-rotate;
		clocks = <&dummy_clk>;
	};

* DMA client

Clients have to specify the DMA requests with phandles in a list.

Required properties:
- dmas:             List of one or more DMA request specifiers. One DMA request specifier
                    consists of a phandle to the DMA controller followed by the integer
                    specifying the request line.
- dma-names:        List of string identifiers for the DMA requests. For the correct
                    names, have a look at the specific client driver.

Example:

	sni_spi1: spi@1e800100 {
		...
		dmas = <&hdmac1 22>, <&hdmac1 21>;
		dma-names = "tx", "rx";
		...
	};
```

## analysis/sources/kernel_selected/linux-4.19.124/Documentation/devicetree/bindings/i2c/i2c-milbeaut.txt
```
Milbeaut I2C

Required properties:
- compatible:        Must be "socionext,m20v-i2c".
- clocks:            Phandle to the clock used by the I2C module.
- interrupts:        Shared peripheral interrupt number of the device's set.
- reg:               Offset and length of the device's register set.
- clock-frequency:   SCL clock frequency.

Example:

	i2c0: i2c@1e003000 {
		compatible = "socionext,m20v-i2c";
		reg = <0x1e003000 0x400>;
		interrupts = <0 101 4>;
		clocks = <&pclk>;
		clock-frequency = <100000>;
	};
```

## analysis/sources/kernel_selected/linux-4.19.124/Documentation/devicetree/bindings/pci/milbeaut-pcie.txt
```
Socionext Milbeaut PCIe host and endpoint controller binding

This describes the devicetree bindings for PCIe host and endpoint(EP)
controller implemented on Socionext Milbeaut SoC.

Milbeaut PCIe host and EP controller is based on the Synopsys DesignWare
PCI core. It shares common functions with the PCIe DesignWare core driver and
inherits common properties defined in
Documentation/devicetree/bindings/pci/designware-pcie.txt.

In M20V, there are two PCIe host controllers, but they can not be driven at
the same time unless enabling bifurcation mode.
On the other hand, PCIe EP controller can not be available bifurcation.

Required properties:
- compatible: Should be either
	"socionext,milbeaut-pcie-rc" - host not using bifurcaiton
	"socionext,milbeaut-pcie-rc-bifur" - host using bifurcation
	"socionext,milbeaut-pcie-ep" - EP
- reg: Specifies offset and length of the register set for the device.
	According to the reg-names, appropriate register sets are required.
- reg-names: Must include the following entries:
	"dbi" - controller configuration registers
	"config" - PCIe configuration space for host
	"addr_space" - PCIe configuration space for EP
	"ctrl" - PCIe subsystem registers
- clocks: A phandle to the clocks for PCIe glue layer including
	   the PCIe controller.
- clock-names: Must include the following entries:
	"auxclk" - PCIe AUX clk
	"busclk" - PCIe bus clk
- resets: A phandle to the reset line and sequence for PCIe glue layer
	including the PCIe controller.
- reset-names: Must include the following entries:
	"pwr" - PCIe power
	"soft" - PCIe software reset by cold reset
	"bifu" - PCIe bifucation switch(No setting required for karine)
	"dev" - PCIe device_type switch
- interrupts: A list of interrupt specifiers. According to the
	       interrupt-names, appropriate interrupts are required.
- interrupt-names: Must include the following entries:
	"msi" - msi interrupt for host
	"dma" - dma interrupt

Required sub-node for host:
- legacy-interrupt-controller: Specifies interrupt controller for legacy PCI
				interrupts.

Required properties for legacy-interrupt-controller:
- interrupt-controller: identifies the node as an interrupt controller.
- #interrupt-cells: specifies the number of cells needed to encode an
		     interrupt source. The value must be 1.
- interrupt-parent: Phandle to the parent interrupt controller.
- interrupts: An interrupt specifier for legacy interrupt.

Optional properties for non bifurcaiton host:
- bifur-node: A phandle of the bifurcation host, if exist.
- prsnt2-gpios: A GPIO pin of PRSNT2 which needs to be LOW output
		for card detection if needed. Note that this will be
		ignored if "bifur-node" is enabled.

Example host without bifurcation:

pcie0: pcie@1b000000 {
	compatible = "socionext,milbeaut-pcie-rc", "snps,dw-pcie";
	device_type = "pci";
	reg = <0x1b000000 0x400000>, <0x1a7f0000 0x10000>,
	      <0x1bb00000 0x100>;
	reg-names = "dbi", "config",
		    "ctrl",
	#address-cells = <3>;
	#size-cells = <2>;
	clocks = <&clk M20V_PCIE_AUX_ID>, <&clk M20V_ACLK_PCIE0_ID>;
	clock-names = "auxclk", "busclk";
	resets = <&rst M20V_PCIE_RESET_PWR>, <&rst M20V_PCIE_RESET_SOFT0>,
		 <&rst M20V_PCIE_RESET_BIFU>, <&rst M20V_PCIE_RESET_CNT0_MODE>;
	reset-names = "pwr", "soft",
		      "bifu", "dev";
	num-lanes = <4>;
	num-viewport = <4>;
	bus-range = <0x0 0xff>;
	ranges = <0x81000000 0 0x00000000 0x1a7e0000 0 0x00010000>.
		 <0x82000000 0 0x1a000000 0x1a000000 0 0x007e0000>;
	interrupts = <0 386 4>, <0 387 4>;
	interrupt-names ="msi", "dma";
	#interrupt-cells = <1>;
	interrupt-map-mask = <0 0 0 0x7>;
	interrupt-map = <0 0 0 1 &pcie_intc 3>, /* int_a */
			<0 0 0 2 &pcie_intc 2>, /* int_b */
			<0 0 0 3 &pcie_intc 1>, /* int_c */
			<0 0 0 4 &pcie_intc 0>; /* int_d */
	pcie_intc: legacy-interrupt-controller {
		interrupt-controller;
		#interrupt-cells = <1>;
		interrupt-parent = <&gic>;
		interrupts = <0 385 4>;
	};
};

Example host with bifurcation:

 Most of them are same as not bifurcation
 the compatible and the num-lanes are different
 "num-lanes" must be <2>

pcie0: pcie@1b000000 {
	compatible = "socionext,milbeaut-pcie-rc-bifur", "snps,dw-pcie";

	...[snip]...

	num-lanes = <2>;

	...[snip]...
};

 As controller 1 has different addresses and SPIs from 0,
 it is not abbreviated

pcie1: pcie@1b400000 {
	compatible = "socionext,milbeaut-pcie-rc-bifur", "snps,dw-pcie";
	status = "disabled";
	device_type = "pci";
	reg = <0x1b400000 0x400000>, <0x1aff0000 0x10000>,
	      <0x1bb00200 0x100>;
	reg-names = "dbi", "config",
		    "ctrl";
	#address-cells = <3>;
	#size-cells = <2>;
	clocks = <&clk M20V_PCIE_AUX_ID>, <&clk M20V_ACLK_PCIE1_ID>;
	clock-names = "auxclk", "busclk";
	resets = <&rst M20V_PCIE_RESET_PWR>, <&rst M20V_PCIE_RESET_SOFT1>,
		 <&rst M20V_PCIE_RESET_BIFU>, <&rst M20V_PCIE_RESET_CNT1_MODE>;
	reset-names = "pwr", "soft",
		      "bifu", "dev";
	num-lanes = <2>;
	num-viewport = <4>;
	ranges = <0x81000000 0 0x00000000 0x1afe0000 0 0x00010000>.
		 <0x82000000 0 0x1a800000 0x1a800000 0 0x007e0000>;
	interrupts = <0 389 4>, <0 390 4>;
	interrupt-names ="msi", "dma";
	#interrupt-cells = <1>;
	interrupt-map-mask = <0 0 0 0x7>;
	interrupt-map = <0 0 0 1 &pcie_intc 3>, /* int_a */
			<0 0 0 2 &pcie_intc 2>, /* int_b */
			<0 0 0 3 &pcie_intc 1>, /* int_c */
			<0 0 0 4 &pcie_intc 0>; /* int_d */
	pcie_intc: legacy-interrupt-controller {
		interrupt-controller;
		#interrupt-cells = <1>;
		interrupt-parent = <&gic>;
		interrupts = <0 388 4>;
	};
};

Example EP:

pcie0: pcie@1b000000 {
	compatible = "socionext,milbeaut-pcie-ep", "snps,dw-pcie";
	status = "disabled";
	reg = <0x1b000000 0x400000>, <0x1a000000 0x800000>,
	      <0x1bb00000 0x100>;
	reg-names = "dbi", "addr_space",
		    "ctrl",
	clocks = <&clk M20V_PCIE_AUX_ID>, <&clk M20V_ACLK_PCIE0_ID>;
	clock-names = "auxclk", "busclk";
	resets = <&rst M20V_PCIE_RESET_PWR>, <&rst M20V_PCIE_RESET_SOFT0>,
		 <&rst M20V_PCIE_RESET_BIFU>, <&rst M20V_PCIE_RESET_CNT0_MODE>;
	reset-names = "pwr", "soft",
		      "bifu", "dev";
	num-ib-windows = <8>;
	num-ob-windows = <8>;
	num-lanes = <4>;
	interrupts = <0 422 4>;
	interrupt-names ="dma";
};
```

## analysis/sources/kernel_selected/linux-4.19.124/Documentation/devicetree/bindings/pwm/pwm-milbeaut.txt
```
Socionext Milbeaut PWM controller

Required properties:
- compatible:	should be "socionext,milbeaut-pwm"
- reg:		physical base address and length of the controller's registers.
- clocks:	phandle and clock specifier of the PWM reference clock.
- #pwm-cells:	must be 3. See pwm.txt in this directory for a
		description of the cell format.

Optional properties:
- base-rate:	set the rate of the clock to this at probe.

Example:

	pwm0: pwm@1e120000 {
		compatible = "socionext,milbeaut-pwm";
		reg = <0x1e001000 0x400>;
		clocks = <&rclk>;
		#pwm-cells = <3>;
		base-rate = <13500000>;
	};
```

## analysis/sources/kernel_selected/linux-4.19.124/Documentation/devicetree/bindings/reset/milbeaut-reset.txt
```
Milbeaut reset controller

Reset EXS macros (UHS-I/II, Nand Flash, USB e.t.c.) and control
their registers on EXSTOP.
------------

oncell_IDs are listed below,
include/dt-bindings/reset/milbeaut,m20v.reset.h

Required properties:
- compatible: should be "socionext,milbeaut-m20v-reset"
- reg: should be two regs
- reg-names: should be below names
	"exstop" - EM_SRSTX of EXS
	"pcie_apb" - pcie subsystem reset part of EXS
- #reset-cells: should be 1.

Example:

rst: reset{
	compatible = "socionext,milbeaut-m20v-reset";
	reg = <0x1ba00200 0x20>, <0x1bb00e00 0x80>;
	reg-names = "exstop", "pcie_apb";
	#reset-cells = <1>;
};

Consumer node example:

pcie0: pcie@1b000000 {
	compatible = "socionext,milbeaut-pcie-rc", "snps,dw-pcie";

	...[snip]...

	resets = <&rst M20V_PCIE_RESET_PWR>, <&rst M20V_PCIE_RESET_SOFT0>,
		 <&rst M20V_PCIE_RESET_BIFU>, <&rst M20V_PCIE_RESET_CNT0_MODE>;
	reset-names = "pwr", "soft",
		      "bifu", "dev";

	...[snip]...

};
```

## analysis/sources/kernel_selected/linux-4.19.124/Documentation/devicetree/bindings/spi/spi-milbeaut.txt
```
Milbeaut SPI

Required properties:
- compatible:        Must be "socionext,milbeaut-spi".
- clocks:            Phandle to the clock used by the SPI module.
- interrupts:        Shared peripheral interrupt number of the device's set.
- reg:               Offset and length of the device's register set.
- dmas:              DMA specifier, consisting of a phandle to DMA controller node.
- dma-names:         DMA request names should include "tx" and "rx" if present.
- fifo_size:         SPI module FIFO size. The size is fixed in module.
                       spi@1e800000(CH0): 128 word
                       spi@1e800100(CH1):  64 word
                       spi@1e800200(CH2):  16 word
- cs_nums:           Number of chip select signals that require gpio settings.
- dma_mode:          Set to <1> to use DMA mode.
                     Set to <0> to use SPI mode.
- spi-max-frequency: Max frequency of spi bus.
- ssout-cont:        Controls the slave select signal.
                       <0>: Inactive per transfer.
                       <1>: Inactive when FIFO is empty.
                       <2>: Inactive after stopping SPI macro.
- ss:                Number of SPI slave select <0-3>.

Example:

	sni_spi1: spi@1e800100 {
		compatible = "socionext,milbeaut-spi";
		clocks = <&spiclk>;
		interrupts = <0 157 4>;
		reg = <0x1e800100 0x100>;
		#address-cells = <1>;
		#size-cells = <0>;
		dmas = <&hdmac1 22>, <&hdmac1 21>;
		dma-names = "tx", "rx";
		fifo_size = <64>;
		cs-nums = <2>;
		dma_mode = <1>;

		spi0@0 {
			compatible = "socionext,milbeaut-spidev";
			reg = <0>;
			spi-max-frequency = <10000000>;
			ssout-cont = <2>;
			ss = <0>;
		};

		spi1@1 {
			compatible = "socionext,milbeaut-spidev";
			reg = <1>;
			spi-max-frequency = <10000000>;
			ssout-cont = <2>;
			ss = <1>;
		};

	};
```

## analysis/sources/leica_sl3_selected/linux-4.19.124/Documentation/devicetree/bindings/arm/milbeaut.txt
```
Milbeaut platforms device tree bindings
---------------------------------------

- Milbeaut M10V Evaluation Board
    Required root node properties:
      - compatible = "socionext,milbeaut-m10v-evb", "socionext,sc2000a";
```

## analysis/sources/leica_sl3_selected/linux-4.19.124/Documentation/devicetree/bindings/clock/milbeaut-clock.txt
```
Milbeaut SoCs Clock Controller Binding
----------------------------------------
Milbeaut SoCs Clock controller is an integrated clock controller, which
generates and supplies to all modules.

This binding uses common clock bindings
[1] Documentation/devicetree/bindings/clock/clock-bindings.txt
[2] include/dt-bindings/clock/milbeaut,m20v-clock.h
[3] include/dt-bindings/clock/milbeaut,m10v-clock.h

Required properties:
- compatible: should be one of the following:
    "socionext,milbeaut-m10v-ccu" - for M10V SoC
    "socionext,milbeaut-m20v-ccu" - for M20V SoC
- reg: shall contain base address and length of clock registers
- #clock-cells: shall be 1 for M10V SoC
- clocks:
    shall be an external clock for M10V SoC
    shall be three(two) external clock for M20V SoC
- clock-names:
    shall be "UCLKXI", "AUMCLKI" for M20V SoC
    and "GENCLK" is an optional.

Example: Clock controller node:

	clk: m10v-clk-ctrl@1d021000 {
		compatible = "socionext,milbeaut-m10v-clk-ccu";
		reg = <0x1d021000 0x4000>;
		#clock-cells = <1>
		clocks = <&clki40mhz>
	};

	clk: m20v-clk-ctrl@d152000 {
		compatible = "socionext,milbeaut-m20v-clk-ccu";
		reg = <0xd152000 0x5000>;
		clocks = <&clki48mhz>, <&clki196mhz>, <&clki27mhz>;
		clock-names = "UCLKXI", "AUMCLKI", GENCLK";
	};

Example: Required an external clock for Clock controller node:

	clocks {
		clki40mhz: clki40mhz {
			compatible = "fixed-clock";
			#clock-cells = <0>;
			clock-frequency = <40000000>;
		};
		clki48mhz: clki48mhz {
			compatible = "fixed-clock";
			#clock-cells = <0>;
			clock-frequency = <48000000>;
		};
		clki196mhz: clki196mhz {
			compatible = "fixed-clock";
			#clock-cells = <0>;
			clock-frequency = <196000000>;
		};
		clki27mhz: clki27mhz {
			compatible = "fixed-clock";
			#clock-cells = <0>;
			clock-frequency = <27000000>;
		};
	};

The clock consumer shall specify the desired clock-output of the clock
controller as below by specifying output-id in its "clk" phandle cell.
For M10V SoC:
    see [3]
For M20V SoC:
    see [2]

Example: uart1 node in M10V SoC
	uart1: serial@1e700010 {
		compatible = "socionext,milbeaut-usio-uart";
		reg = <0x1e700010 0x10>;
		interrupts = <0 141 0x4>, <0 149 0x4>;
		interrupt-names = "rx", "tx";
		clocks = <&clk M10V_HCLK_ID>;
	};

Example: 32-bit timer node in M20V SoC
	timer: timer@e000000
		compatible = "socionext,milbeaut-timer";
		reg = <0xe000000 0x20>;
		interrupts = <0 247 0x4>;
		clocks = <&clk M20V_RCLK_ID>;
	};
```

## analysis/sources/leica_sl3_selected/linux-4.19.124/Documentation/devicetree/bindings/iio/counter/milbeaut-timer64.txt
```
SOCIONEXT Milbeaut Timer64 counter

Required properties:
- compatible:	Must be "socionext,milbeaut-timer64".
- clocks:	set clock driver with M20V_TMR64CLK_ID.
- clock-name:	Must be "base".
- dmas:	set hdmac's phandle and set value which specify corresponding
		IDREQ no.
- dma-names: set "rx".

Example:

	timer64_0: timer64_0@e001000 {
		compatible = "socionext,milbeaut-timer64";
		reg = <0x0e001000 0x400>;
		clocks = <&clk M20V_TMR64CLK_ID>;
		clock-names = "base";
		dmas = <&hdmac1 40>;
		dma-names = "rx";
	};
```
